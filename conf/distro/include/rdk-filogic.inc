## conf/machine/filogic655-logan-be3600-mt7987-mt7990.conf
```bitbake
#@TYPE: Machine
#@NAME: mediatek filogic
#@NEEDED_BSPLAYERS: meta-filogic
#@DESCRIPTION: Machine configuration for running a RDK broadband on mediatek filogic
#@RDK_FLAVOR: rdkb

include conf/machine/filogic.conf

MACHINE_EXTRA_RRECOMMENDS += "kernel-modules"

MACHINE_IMAGE_NAME = "rdkb-generic-broadband-image"

MACHINEOVERRIDES .= ":broadband:filogic:mt7987:mt7993:mt7993-be3600"

PREFERRED_PROVIDER_u-boot-fw-utils = "libubootenv"

PREFERRED_VERSION_xfsprogs = "4.8.0"
PREFERRED_VERSION_php_dunfell = "7.1.%"
PREFERRED_VERSION_php-native_dunfell = "7.1.%"

PREFERRED_PROVIDER_virtual/kernel = "linux-mediatek"
PREFERRED_PROVIDER_virtual/bootloader = "u-boot"
PREFERRED_VERSION_linux-mediatek = "5.4.%"
PREFERRED_VERSION_linux-libc-headers = "5.4"

PREFERRED_PROVIDER_hal-wifi = "hal-wifi-logan"
PREFERRED_VERSION_iw_filogic = "5.%"
#PREFERRED_PROVIDER_hal-wifi = "hal-wifi-mt76"
#PREFERRED_VERSION_iw_filogic = "6.%"
#PREFERRED_VERSION_lua = "5.3.%"

#wifi bsp from openwrt - logan
PREFERRED_VERSION_hostapd = "2.10"
PREFERRED_VERSION_wpa-supplicant = "2.10"

#wifi bsp from openwrt - mt76
PREFERRED_VERSION_linux-mac80211 = "6.%"
#PREFERRED_VERSION_linux-mt76 = "3.%"
#PREFERRED_VERSION_hostapd = "2.11"
#PREFERRED_VERSION_wpa-supplicant_filogic = "2.11"
#PREFERRED_VERSION_json-c = "0.15"
#PREFERRED_VERSION_linux-mac80211 = "5.15.%"
#PREFERRED_VERSION_linux-mt76 = "2.%"

#masking files for dunfell build
require conf/include/filogic-bbmasks.inc
#require conf/include/rdk-external-src-platform.inc

DISTRO_FEATURES:append = " meshwifi"
DISTRO_FEATURES:append = " ipv6"
DISTRO_FEATURES:append = " kernel_in_ubi"
#DISTRO_FEATURES:append = " switch_gsw_mode"
DISTRO_FEATURES:append = " fwupgrade_manager"
#DISTRO_FEATURES:append = " mt76"
#DISTRO_FEATURES:append = " flow_offload"
#DISTRO_FEATURES:append = " wifi_eht"
DISTRO_FEATURES:append = " logan"
#DISTRO_FEATURES:append = " mtk_easymesh"
# kernel 5.4 gold linker 'arm-rdk-linux-gnueabi-ld' not supported
#DISTRO_FEATURES:append = " referencepltfm "
#DISTRO_FEATURES:remove = " ld-is-gold"
DISTRO_FEATURES:append = " scnrdo"

BBMASK .= "|meta-filogic/recipes-wifi/"
BBMASK .= "|meta-filogic-logan/recipes-mtk-mesh/1905daemon"
BBMASK .= "|meta-filogic-logan/recipes-mtk-mesh/libmapd"
BBMASK .= "|meta-filogic-logan/recipes-mtk-mesh/libwpactrl"
BBMASK .= "|meta-filogic-logan/recipes-mtk-mesh/mapd"
BBMASK .= "|meta-filogic-logan/recipes-mtk-mesh/mapfilter"
BBMASK .= "|meta-filogic-logan/recipes-mtk-mesh/wappd"
BBMASK .= "|meta-filogic-logan/recipes-netsys/"

DISTRO_FEATURES:append = " emmc"
DISTRO_FEATURES:append = " mt7987"
#select logan config
#for mt7993-be3600
DISTRO_FEATURES:append = " mt7993-be3600"
MACHINEOVERRIDES .="${@bb.utils.contains('DISTRO_FEATURES','mt7993-be3600',':mt7993-be3600','',d)}"

#for sdk support
INHERIT:append = " uninative"
BB_SETSCENE_ENFORCE_IGNORE_TASKS:append = " %:* *:do_fetch *"

BOOT_SUFFIX = "bin"
MACHINE_FEATURES = "ext2 ipsec nfs pci smbfs usbgadget usbhost vfat"

#for secure boot support
#DISTRO_FEATURES:append = " secure_boot"
MACHINEOVERRIDES .="${@bb.utils.contains('DISTRO_FEATURES','secure_boot',':secureboot','',d)}"
SECURE_BOOT_KEYNAME_secureboot = "fit_key"
SECURE_BOOT_KEYDIR_secureboot = "${TOPDIR}/../keys"
FIT_HASH_ALG_secureboot ="sha1"
HASHED_BOOT_DEVICE_secureboot = "252:0"
```

## conf/machine/filogic830-32bit.conf
```bitbake
#@TYPE: Machine
#@NAME: mediatek filogic
#@NEEDED_BSPLAYERS: meta-filogic
#@DESCRIPTION: Machine configuration for running a RDK broadband on mediatek filogic
#@RDK_FLAVOR: rdkb

include conf/machine/filogic-32bit.conf

MACHINE_EXTRA_RRECOMMENDS += "kernel-modules"

MACHINE_IMAGE_NAME = "rdkb-generic-broadband-image"

MACHINEOVERRIDES .= ":broadband:filogic-32bit:mt7986-32bit"

PREFERRED_PROVIDER_u-boot-fw-utils = "libubootenv"

PREFERRED_VERSION_xfsprogs = "4.8.0"
PREFERRED_VERSION_php_dunfell = "7.1.%"
PREFERRED_VERSION_php-native_dunfell = "7.1.%"

PREFERRED_PROVIDER_virtual/kernel = "linux-mediatek"
PREFERRED_PROVIDER_virtual/bootloader = "u-boot"
PREFERRED_VERSION_linux-mediatek = "5.4.%"
PREFERRED_VERSION_linux-libc-headers = "5.4"

#masking files for dunfell build
require conf/include/filogic-bbmasks.inc
#require conf/include/rdk-external-src-platform.inc

DISTRO_FEATURES:append = " meshwifi"
DISTRO_FEATURES:append = " ipv6"
DISTRO_FEATURES:append = " kernel_in_ubi"
#DISTRO_FEATURES:append = " switch_gsw_mode"
DISTRO_FEATURES:append = " fwupgrade_manager"
DISTRO_FEATURES:append = " mt76"
DISTRO_FEATURES:append = " flow_offload"
#DISTRO_FEATURES:append = " logan"
#DISTRO_FEATURES:append = " mtk_easymesh"
# kernel 5.4 gold linker 'arm-rdk-linux-gnueabi-ld' not supported
#DISTRO_FEATURES:append = " referencepltfm "
#DISTRO_FEATURES:remove = " ld-is-gold"
DISTRO_FEATURES:remove = " three_gmac"
BBMASK .= "|meta-filogic-logan/recipes-wifi/"
#for sdk support
INHERIT:append = " uninative"
BB_SETSCENE_ENFORCE_IGNORE_TASKS:append = " %:* *:do_fetch *"

BOOT_SUFFIX = "bin"
MACHINE_FEATURES = "ext2 ipsec nfs pci smbfs usbgadget usbhost vfat"
```

## conf/machine/filogic860-logan-sdb-be3600-7988d-ccn34.conf
```bitbake
# SPDX-License-Identifier: GPL-2.0-only
#
# Copyright (C) 2023 MediaTek Inc.
#
#@TYPE: Machine
#@NAME: mediatek filogic
#@NEEDED_BSPLAYERS: meta-filogic
#@DESCRIPTION: Machine configuration for running a RDK broadband on mediatek filogic
#@RDK_FLAVOR: rdkb

include conf/machine/filogic860-logan-sdb-be3600-7988d.conf

PREFERRED_VERSION_iproute2 = "6.7.0"

DISTRO_FEATURES:append = " ccn34"
DISTRO_FEATURES:append = " switch_gsw_mode"
DISTRO_FEATURES:append = " scnrdo"
DISTRO_FEATURES:append = " owl"
DISTRO_FEATURES:append = " eip-197-inline"
DISTRO_FEATURES:append = " capwap-dtls"
#DISTRO_FEATURES:append = " emmc"

DISTRO_FEATURES:remove = " meshwifi"
DISTRO_FEATURES:remove = " mtk_easymesh"
```

## conf/machine/filogic880-kernel6-6-onewifi.conf
```bitbake
# SPDX-License-Identifier: GPL-2.0-only
#
# Copyright (C) 2023 MediaTek Inc.
#
#@TYPE: Machine
#@NAME: mediatek filogic
#@NEEDED_BSPLAYERS: meta-filogic
#@DESCRIPTION: Machine configuration for running a RDK broadband on mediatek filogic
#@RDK_FLAVOR: rdkb

include conf/machine/filogic-kernelv6.conf

MACHINE_EXTRA_RRECOMMENDS += "kernel-modules"

MACHINE_IMAGE_NAME = "rdkb-generic-broadband-image"

MACHINEOVERRIDES .= ":broadband:filogic:mt7988:mt7990:mt7988a:kernelv6"

PREFERRED_PROVIDER_u-boot-fw-utils = "libubootenv"

PREFERRED_VERSION_xfsprogs = "4.8.0"
PREFERRED_VERSION_php_dunfell = "7.1.%"
PREFERRED_VERSION_php-native_dunfell = "7.1.%"

PREFERRED_PROVIDER_virtual/kernel = "linux-mediatek"
PREFERRED_PROVIDER_virtual/bootloader = "u-boot"
PREFERRED_VERSION_linux-mediatek = "6.6.%"
PREFERRED_VERSION_linux-libc-headers = "6.6"

PREFERRED_PROVIDER_hal-wifi_onewifi = "hal-wifi-generic"
PREFERRED_VERSION_iw_filogic = "6.%"
PREFERRED_VERSION_lua = "5.3.%"
#wifi bsp from openwrt
PREFERRED_VERSION_linux-mac80211 = "6.%"
PREFERRED_VERSION_linux-mt76 = "3.%"
PREFERRED_VERSION_hostapd = "2.11"
PREFERRED_VERSION_wpa-supplicant_filogic = "2.11"
PREFERRED_VERSION_json-c = "0.15"


#masking files for dunfell build
require conf/include/filogic-bbmasks.inc
#require conf/include/rdk-external-src-platform.inc

DISTRO_FEATURES:append = " meshwifi"
DISTRO_FEATURES:append = " ipv6"
DISTRO_FEATURES:append = " kernel_in_ubi"
#DISTRO_FEATURES:append = " switch_gsw_mode"
DISTRO_FEATURES:append = " fwupgrade_manager"
DISTRO_FEATURES:append = " mt76"
DISTRO_FEATURES:append = " flow_offload"
DISTRO_FEATURES:append = " wifi_eht"
DISTRO_FEATURES:append = " kernelv6"
DISTRO_FEATURES:append = " mt7996"
#DISTRO_FEATURES:append = " mtk_easymesh"
# kernel 5.4 gold linker 'arm-rdk-linux-gnueabi-ld' not supported
#DISTRO_FEATURES:append = " referencepltfm "
#DISTRO_FEATURES:remove = " ld-is-gold"
BBMASK .= "|meta-filogic-logan/recipes-wifi/"
#for sdk support
INHERIT:append = " uninative"

BOOT_SUFFIX = "bin"
MACHINE_FEATURES = "ext2 ipsec nfs pci smbfs usbgadget usbhost vfat"

#for secure boot support
#DISTRO_FEATURES:append = " secure_boot"
MACHINEOVERRIDES .="${@bb.utils.contains('DISTRO_FEATURES','secure_boot',':secureboot','',d)}"
SECURE_BOOT_KEYNAME_secureboot = "fit_key"
SECURE_BOOT_KEYDIR_secureboot = "${TOPDIR}/../keys"
FIT_HASH_ALG_secureboot ="sha1"
HASHED_BOOT_DEVICE_secureboot = "252:0"

# for efuse tools
#DISTRO_FEATURES:append = " efuse_tools"

DISTRO_FEATURES_append = " halVersion3"

#rdk-wifi-libhostap support for broadband
DISTRO_FEATURES_append = " HOSTAPD_2_11"

# OneWifi feature
DISTRO_FEATURES_append = " OneWifi onewifi_integration"

# MacFilter Feature
DISTRO_FEATURES_append = " disable_nl80211_acl"

#No Moca Support
DISTRO_FEATURES_append = " no_moca_support"
#Enable wps support
DISTRO_FEATURES_append = " wps_support"

#Enable resource optimization
DISTRO_FEATURES_append = " resource_optimization"

#Enable kernel_6_6 support
DISTRO_FEATURES_append = " kernelv6"

DISTRO_FEATURES_append = " CONFIG_IEEE80211BE"

#DISTRO_FEATURES_append = " generic_mlo"


BBMASK .= "|meta-cmf-bananapi/meta-rdk-mtk-bpir4/recipes-core/images/"
BBMASK .= "|meta-cmf-bananapi/meta-rdk-mtk-bpir4/recipes-kernel/linux/"
BBMASK .= "|meta-cmf-bananapi/meta-rdk-mtk-bpir4/recipes-kernel/linux-firmware/"
BBMASK .= "|meta-filogic/recipes-wifi/hal/rdk-wifi-halif.bbappend"
```

## conf/machine/filogic880-logan-be7200.conf
```bitbake
# SPDX-License-Identifier: GPL-2.0-only
#
# Copyright (C) 2023 MediaTek Inc.
#
#@TYPE: Machine
#@NAME: mediatek filogic
#@NEEDED_BSPLAYERS: meta-filogic
#@DESCRIPTION: Machine configuration for running a RDK broadband on mediatek filogic
#@RDK_FLAVOR: rdkb

include conf/machine/filogic.conf

MACHINE_EXTRA_RRECOMMENDS += "kernel-modules"

MACHINE_IMAGE_NAME = "rdkb-generic-broadband-image"

MACHINEOVERRIDES .= ":broadband:filogic:mt7988"

PREFERRED_PROVIDER_u-boot-fw-utils = "libubootenv"

PREFERRED_VERSION_xfsprogs = "4.8.0"
PREFERRED_VERSION_php_dunfell = "7.1.%"
PREFERRED_VERSION_php-native_dunfell = "7.1.%"

PREFERRED_PROVIDER_virtual/kernel = "linux-mediatek"
PREFERRED_PROVIDER_virtual/bootloader = "u-boot"
PREFERRED_VERSION_linux-mediatek = "5.4.%"
PREFERRED_VERSION_linux-libc-headers = "5.4"

PREFERRED_PROVIDER_hal-wifi = "hal-wifi-logan"
PREFERRED_VERSION_iw_filogic = "5.%"
#wifi bsp from openwrt
PREFERRED_VERSION_hostapd = "2.10"
PREFERRED_VERSION_wpa-supplicant = "2.10"


#masking files for dunfell build
require conf/include/filogic-bbmasks.inc
#require conf/include/rdk-external-src-platform.inc

DISTRO_FEATURES:append = " meshwifi"
DISTRO_FEATURES:append = " ipv6"
DISTRO_FEATURES:append = " kernel_in_ubi"
#DISTRO_FEATURES:append = " switch_gsw_mode"
DISTRO_FEATURES:append = " fwupgrade_manager"
#DISTRO_FEATURES:append = " mt76"
#DISTRO_FEATURES:append = " flow_offload"
DISTRO_FEATURES:append = " logan"
DISTRO_FEATURES:append = " mtk_easymesh"
# kernel 5.4 gold linker 'arm-rdk-linux-gnueabi-ld' not supported
#DISTRO_FEATURES:append = " referencepltfm "
#DISTRO_FEATURES:remove = " ld-is-gold"

DISTRO_FEATURES:append = " 2022q3_support"
DISTRO_FEATURES:remove = " core-net-lib"

DISTRO_FEATURES:append = " kite"

BBMASK .= "|meta-filogic/recipes-wifi/"

#for mt7992-be7200
DISTRO_FEATURES:append = " mt7992-be7200"
MACHINEOVERRIDES .="${@bb.utils.contains('DISTRO_FEATURES','mt7992-be7200',':mt7992-be7200','',d)}"
#for sdk support
INHERIT:append = " uninative"
BB_SETSCENE_ENFORCE_IGNORE_TASKS:append = " %:* *:do_fetch *"

BOOT_SUFFIX = "bin"
MACHINE_FEATURES = "ext2 ipsec nfs pci smbfs usbgadget usbhost vfat"

#for secure boot support
#DISTRO_FEATURES:append = " secure_boot"
MACHINEOVERRIDES .="${@bb.utils.contains('DISTRO_FEATURES','secure_boot',':secureboot','',d)}"
SECURE_BOOT_KEYNAME_secureboot = "fit_key"
SECURE_BOOT_KEYDIR_secureboot = "${TOPDIR}/../keys"
FIT_HASH_ALG_secureboot ="sha1"
HASHED_BOOT_DEVICE_secureboot = "252:0"
```

## conf/machine/filogic880-logan-ccn34.conf
```bitbake
#@TYPE: Machine
#@NAME: mediatek filogic
#@NEEDED_BSPLAYERS: meta-filogic
#@DESCRIPTION: Machine configuration for running a RDK broadband on mediatek filogic
#@RDK_FLAVOR: rdkb

include conf/machine/filogic.conf
include conf/machine/filogic880-logan.conf

PREFERRED_VERSION_iproute2 = "6.7.0"

DISTRO_FEATURES:append = " ccn34"
DISTRO_FEATURES:append = " eagle"
DISTRO_FEATURES:append = " scnrdo"
DISTRO_FEATURES:remove = " meshwifi"
DISTRO_FEATURES:remove = " mtk_easymesh"
DISTRO_FEATURES:append = " switch_gsw_mode"
DISTRO_FEATURES:append = " eip-197-inline"
DISTRO_FEATURES:append = " capwap-dtls"
```

## conf/machine/include/tune-cortexa7-soft.inc
```bitbake
DEFAULTTUNE = "cortexa7-soft"

AVAILTUNES += "cortexa7-soft"

require conf/machine/include/tune-cortexa7.inc

TUNEVALID[fpu-soft] = "Use software FPU."
TUNE_CCARGS .= "${@bb.utils.contains('TUNE_FEATURES', 'fpu-soft', ' -msoft-float', '', d)}"
TARGET_FPU = "${@bb.utils.contains('TUNE_FEATURES', 'fpu-soft', 'soft', '', d)}"

# Basic tune definitions
ARMPKGARCH:tune-cortexa7-soft = "cortexa7"
TUNE_FEATURES:tune-cortexa7-soft = "${TUNE_FEATURES:tune-cortexa7} fpu-soft"
PACKAGE_EXTRA_ARCHS:tune-cortexa7-soft  = "${PACKAGE_EXTRA_ARCHS:tune-armv7ve} cortexa7-vfp fpu-soft"
```
